## config/boards/shields/nice_kb/Kconfig.defconfig
```kconfig
if SHIELD_NICE_KB_LEFT

config ZMK_KEYBOARD_NAME
	default "nice_kb"

config ZMK_SPLIT_ROLE_CENTRAL
	default y

endif # SHIELD_NICE_KB_LEFT

if SHIELD_NICE_KB_LEFT || SHIELD_NICE_KB_RIGHT

config ZMK_SPLIT
	default y

endif

if SHIELD_NKBTEST

config ZMK_KEYBOARD_NAME
	default "nkbtest"

endif # SHIELD_NKBTEST

if SHIELD_NKBSCROLL

config ZMK_KEYBOARD_NAME
	default "nkbscroll"

endif # SHIELD_NKBSCROLL

if SHIELD_NKBINERTIA

config ZMK_KEYBOARD_NAME
	default "nkbinertia"

endif # SHIELD_NKBINERTIA

if SHIELD_NKBROTATE

config ZMK_KEYBOARD_NAME
	default "nkbrotate"

endif # SHIELD_NKBROTATE

if SHIELD_NKBTUNE_A

config ZMK_KEYBOARD_NAME
	default "nkbtune_a"

endif # SHIELD_NKBTUNE_A

if SHIELD_NKBTUNE_B

config ZMK_KEYBOARD_NAME
	default "nkbtune_b"

endif # SHIELD_NKBTUNE_B

if SHIELD_NKBTUNE_C

config ZMK_KEYBOARD_NAME
	default "nkbtune_c"

endif # SHIELD_NKBTUNE_C

if SHIELD_NKBTUNE_D

config ZMK_KEYBOARD_NAME
	default "nkbtune_d"

endif # SHIELD_NKBTUNE_D

if SHIELD_NKBTUNE_E

config ZMK_KEYBOARD_NAME
	default "nkbtune_e"

endif # SHIELD_NKBTUNE_E

if SHIELD_NKBTUNE_F

config ZMK_KEYBOARD_NAME
	default "nkbtune_f"

endif # SHIELD_NKBTUNE_F

if SHIELD_NKBTUNE_600

config ZMK_KEYBOARD_NAME
	default "nkbtune_600"

endif # SHIELD_NKBTUNE_600

if SHIELD_NKBTUNE_700

config ZMK_KEYBOARD_NAME
	default "nkbtune_700"

endif # SHIELD_NKBTUNE_700

if SHIELD_NKBTUNE_800

config ZMK_KEYBOARD_NAME
	default "nkbtune_800"

endif # SHIELD_NKBTUNE_800

if SHIELD_NKBTUNE_900

config ZMK_KEYBOARD_NAME
	default "nkbtune_900"

endif # SHIELD_NKBTUNE_900
```

## config/boards/shields/nice_kb/Kconfig.shield
```kconfig
config SHIELD_NICE_KB_LEFT
	def_bool $(shields_list_contains,nice_kb_left)

config SHIELD_NICE_KB_RIGHT
	def_bool $(shields_list_contains,nice_kb_right)

config SHIELD_NKBTEST
	def_bool $(shields_list_contains,nkbtest)

config SHIELD_NKBSCROLL
	def_bool $(shields_list_contains,nkbscroll)

config SHIELD_NKBINERTIA
	def_bool $(shields_list_contains,nkbinertia)

config SHIELD_NKBROTATE
	def_bool $(shields_list_contains,nkbrotate)

config SHIELD_NKBTUNE_A
	def_bool $(shields_list_contains,nkbtune_a)

config SHIELD_NKBTUNE_B
	def_bool $(shields_list_contains,nkbtune_b)

config SHIELD_NKBTUNE_C
	def_bool $(shields_list_contains,nkbtune_c)

config SHIELD_NKBTUNE_D
	def_bool $(shields_list_contains,nkbtune_d)

config SHIELD_NKBTUNE_E
	def_bool $(shields_list_contains,nkbtune_e)

config SHIELD_NKBTUNE_F
	def_bool $(shields_list_contains,nkbtune_f)
```

## config/west.yml
```yaml
manifest:
  remotes:
    - name: zmkfirmware
      url-base: https://github.com/zmkfirmware
    - name: badjeff
      url-base: https://github.com/badjeff
    - name: kot149
      url-base: https://github.com/kot149
    - name: nlazcani
      url-base: https://github.com/nlazcani
  projects:
    - name: zmk
      remote: zmkfirmware
      revision: main
      import: app/west.yml
    - name: zmk-pmw3610-driver
      remote: badjeff
      revision: main
    - name: zmk-scroll-snap
      remote: kot149
      revision: v1
    - name: zmk-input-processor-scroll-inertia
      remote: nlazcani
      revision: main
    - name: zmk-input-processor-rotate
      remote: nlazcani
      revision: main
  self:
    path: config
```
